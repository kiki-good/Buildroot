## package/UAPIDaemon/Config.in
```kconfig
config BR2_PACKAGE_UAPI
	bool "uapi"
	select BR2_PACKAGE_PKGCONFIG 
	select BR2_PACKAGE_BLUEZ
	help
		Daemon used to communicate with the UEI remote
```

## package/arpcgen/Config.in
```kconfig
config BR2_PACKAGE_ARPCGEN
	bool "arpcgen"
	help
	  RPC Protocol Compiler.
	  A tool that generates C code to
	  implement the RPC protocol.
```

## package/attr/Config.in
```kconfig
config BR2_PACKAGE_ATTR
	bool "attr"
	default n
	select BR2_PACKAGE_PKGCONFIG
	select BR2_PACKAGE_LIBINTL
	help
	  This package contains utilities to 
	  administer the extended attributes 
	  on filesystem objects.
```

## package/bluez/Config.in
```kconfig
config BR2_PACKAGE_BLUEZ
	bool "bluez"
	select BR2_PACKAGE_PKGCONFIG
	select BR2_PACKAGE_EXPAT
	select BR2_PACKAGE_DBUS
	select BR2_PACKAGE_LIBGLIB2 
	select BR2_PACKAGE_DBUS_GLIB
	select BR2_PACKAGE_LIBUSB
	select BR2_PACKAGE_LIBFFI
	select BR2_READLINE	
	select BR2_PACKAGE_READLINE_TARGET	
	select BR2_PACKAGE_READLINE_HEADERS
	select BR2_PACKAGE_ZLIB
	select BR2_PACKAGE_GETTEXT
	select BR2_PACKAGE_UDEV
	select BR2_PACKAGE_LIBSBC
	help
		BlueZ package contains the Bluetooth protocol stack for Linux
```

## package/cares/Config.in
```kconfig
config BR2_PACKAGE_CARES
	bool "cares"
	help
	  c-ares is a C library that performs DNS requests
	   and name resolves asynchronously.
```

## package/collectd/Config.in
```kconfig
config BR2_PACKAGE_COLLECTD
	bool "collectd"
	help
	Collectd is a daemon which collects system 
	performance statistics periodically and provides 
	mechanisms to store the values in a variety of ways.
	collectd gathers statistics about the system it is running on 
	and stores this information. Those statistics can then be used to 
	find current performance analysis and predict 
	future system load (i.e. capacity planning).
```

## package/ctemplate/Config.in
```kconfig
config BR2_PACKAGE_CTEMPLATE
	bool "ctemplate"
	help
	  CTemplate is a simple but powerful template language for C++.
	  It emphasizes separating logic from presentation: it is
	  impossible to embed application logic in this template language. 

	  https://code.google.com/p/ctemplate/
```

## package/ebtables/Config.in
```kconfig
config BR2_PACKAGE_EBTABLES
	bool "ebtables"
	help
	  Ethernet bridge frame table administration

	  http://ebtables.sourceforge.net
```

## package/evtest/Config.in
```kconfig
config BR2_PACKAGE_EVTEST
	bool "evtest"
	help
	  Event test tool mainly for Bluetooth remote
	  http://pkgs.fedoraproject.org/repo/pkgs/evtest/
comment "evtest requires bluetooth to be enabled with uhid device"
```

## package/freetype/Config.in
```kconfig
config BR2_PACKAGE_FREETYPE
	bool "freetype"
	select BR2_PACKAGE_PKGCONFIG
	help
	a free, high-quality and portable font engine.

	http://www.freetype.org/

choice
	prompt "Freetype Version"
	depends on BR2_PACKAGE_FREETYPE
	default BR2_FREETYPE_VERSION_2_5_4
	help
	  Select the version of Freetype you wish to use.

	config BR2_FREETYPE_VERSION_2_2_1
		bool "Freetype 2.2.1"

	config BR2_FREETYPE_VERSION_2_3_7
		bool "Freetype 2.3.7"

	config BR2_FREETYPE_VERSION_2_4_12
		bool "Freetype 2.4.12"

	config BR2_FREETYPE_VERSION_2_5_4
		bool "Freetype 2.5.4"

endchoice

config BR2_FREETYPE_VERSION
	string
	default "2.2.1"		if BR2_FREETYPE_VERSION_2_2_1
	default "2.3.7"		if BR2_FREETYPE_VERSION_2_3_7
	default "2.4.12"	if BR2_FREETYPE_VERSION_2_4_12
	default "2.5.4"		if BR2_FREETYPE_VERSION_2_5_4

config BR2_PACKAGE_FREETYPE_FONTS_TARBALL
	string "Preinstalled fonts tarball?"
	depends on BR2_PACKAGE_FREETYPE
	default "fonts-bskyb-default.tar.gz"
```

## package/gettext/Config.in
```kconfig
config BR2_PACKAGE_GETTEXT
	bool "gettext"
	default n
	select BR2_PACKAGE_PKGCONFIG
	select BR2_PACKAGE_LIBINTL
	select BR2_PACKAGE_ATTR
	help
	  The GNU `gettext' utilities are a set of tools that provide a
	  framework to help other GNU packages produce multi-lingual
	  messages.

	  http://www.gnu.org/software/gettext/

config BR2_PACKAGE_GETTEXT_STATIC
	bool "Use libgettext.a instead of libgettext.so.*"
	depends on BR2_PACKAGE_GETTEXT
	depends on BR2_arm
	default n
	help
	  The GNU `gettext' utilities are a set of tools that provide a
	  framework to help other GNU packages produce multi-lingual
	  messages.

	  http://www.gnu.org/software/gettext/


config BR2_PACKAGE_LIBINTL
	bool "libintl"
	help
	  Selecting this package installs all of gettext in the staging
	  directory and the shared library for it's use in the target.

	  http://www.gnu.org/software/gettext/
```

## package/icu/Config.in
```kconfig
config BR2_PACKAGE_ICU
	bool "icu"
	help
	  International Components for Unicode.

	  http://site.icu-project.org/

if BR2_PACKAGE_ICU

config BR2_PACKAGE_ICU_CUSTOM_DATA_PATH
	string "Path to custom data library file"
	help
	  This option allows to define the path to a custom data
	  library generated with http://apps.icu-project.org/datacustom/
	  Make sure you select the appropiate version to match the one
	  provided by buildroot.
	  Leave empty to not use this functionality.

endif
```

## package/iftop/Config.in
```kconfig
config BR2_PACKAGE_IFTOP
	bool "iftop"
	select BR2_PACKAGE_LIBPCAP
	select BR2_PACKAGE_NCURSES
	help
	iftop does for network usage what top(1) does for CPU usage. 
	It listens to network traffic on a named interface and 
	displays a table of current bandwidth usage by pairs of hosts.
```

## package/iksemel/Config.in
```kconfig
config BR2_PACKAGE_IKSEMEL
	bool "iksemel"
	help
	  Library iksemel is an XML (eXtensible Markup Language)
	  parser mainly designed for Jabber applications.
```

## package/iperf3/Config.in
```kconfig
config BR2_PACKAGE_IPERF3
	bool "iperf3"
	help
	  Internet Protocol bandwidth measuring tool for measuring
	  TCP/UDP performance.

	  http://dast.nlanr.net/projects/iperf/
```

## package/iptables/Config.in
```kconfig
config BR2_PACKAGE_IPTABLES
	bool "iptables"
	help
	  Linux kernel (2.4+) firewall, NAT, and packet mangling tools.

	  http://www.iptables.org/


config BR2_PACKAGE_IPTABLES_IPV6
	bool "IPv6 support"
	default n
	depends on BR2_PACKAGE_IPTABLES
	help
	  Includes support for IPv6 in iptables.


config BR2_PACKAGE_IPTABLES_XML
	bool "iptables-xml"
	default n
	depends on BR2_PACKAGE_IPTABLES
	help
	  The iptables-xml utility.
```

## package/klibc-2.0.3/defconfig
```kconfig
CONFIG_KLIBC=y
CONFIG_KLIBC_ERRLIST=y
CONFIG_KLIBC_ZLIB=y
# CONFIG_KLIBC_ZIP is not set
CONFIG_KLIBC_XZ=y
# i386 option
CONFIG_REGPARM=y
# ARM options
# CONFIG_KLIBC_THUMB is not set
CONFIG_AEABI=y
```

## package/klibc/Config.in
```kconfig
config BR2_PACKAGE_KLIBC
	bool "klibc"
	help
	   klibc is a minimalistic subset of the standard C
	   library.  It contains a basic set of utils for
	   use in an initramfs image.
```

## package/libacl/Config.in
```kconfig
config BR2_PACKAGE_LIBACL
	bool "libacl"
	default N
	select BR2_PACKAGE_ATTR
	help
	  Dynamic library which contains utilities to 
	  administer Access Control Lists, which are 
	  used to define more fine-grained discretionary 
	  access rights for files and directories
```

## package/libatasmart/Config.in
```kconfig
config BR2_PACKAGE_LIBATASMART
	bool "atasmart"
	help
	  A userspace Library for Hard disk monitoring

	  http://www.linuxfromscratch.org/blfs/view/svn/general/libatasmart.html
```

## package/libbsd/Config.in
```kconfig
config BR2_PACKAGE_LIBBSD
	bool "libbsd"
	help
	    This library provides useful functions commonly found on BSD systems,
	    and lacking on others like GNU systems.
```

## package/libcom_err/Config.in
```kconfig
config BR2_PACKAGE_LIBCOM_ERR
	bool "libcom_err"
	help
	    Common Error display Library.
```

## package/libffi/Config.in
```kconfig
config BR2_PACKAGE_LIBFFI
	bool "libffi"
	default n
	select BR2_PACKAGE_PKGCONFIG
	help
	  This library provides a portable, high level programming interface 
	  to various calling conventions. This allows a programmer to call any 
	  function specified by a call interface description at run time.
```

## package/libglib2/Config.in
```kconfig
config BR2_PACKAGE_LIBGLIB2
	bool "libglib2"
	default n
	select BR2_PACKAGE_GETTEXT
	select BR2_PACKAGE_LIBINTL
	select BR2_PACKAGE_LIBICONV if !BR2_ENABLE_LOCALE
	select BR2_PACKAGE_PKGCONFIG
	select BR2_PACKAGE_ZLIB
	select BR2_PACKAGE_LIBFFI
	help
	  Low-level core library that forms the basis of GTK+ and GNOME.

	  http://www.gtk.org/
```

## package/libical/Config.in
```kconfig
config BR2_PACKAGE_LIBICAL
	bool "libical"
	default n
	select BR2_PACKAGE_PKGCONFIG
	help
		The libical package contains an implementation of the 
		iCalendar protocols and data formats.
```
