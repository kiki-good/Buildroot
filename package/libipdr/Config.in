## package/sky-common/mali/Config.in
```kconfig
config BR2_PACKAGE_MALI_GRAPHICS_DEBUGGER
        bool "Mali Graphics Debugger"
        select BR2_PACKAGE_MGD
        select BR2_PACKAGE_MGD_PRELOAD
        default BR2_SKY_DEBUG_BUILD
        help
                Install and enables the mali graphics debugger daemon.
                http://malideveloper.arm.com/resources/tools/mali-graphics-debugger/
                
config BR2_PACKAGE_MGD
        bool "Install Mali Graphics Debugger"

config BR2_PACKAGE_MGD_PRELOAD
        bool "Mali Graphics Debugger preload library"
```

## package/sky-common/nds/Config.in
```kconfig
config BR2_PACKAGE_SKY_NDS_DRIVERS
	bool "NDS drivers"
	default N
	help
	  Include the NDS drivers (i.e. xtvfs, nvram) in the
	  rootfs. If this package is enabled, NDS drivers will be
	  loaded at boot time.

config BR2_PACKAGE_SKY_NDS_MW
	bool "NDS middleware"
	depends on BR2_PACKAGE_SKY_NDS_DRIVERS
	select BR2_PACKAGE_SKY_CDI_DRIVERS
	default N
	help
	  Include the NDS middleware in the rootfs. If this package is
	  included, NDS middleware will be automatically started at
	  boot time.
```

## package/sky-common/rhad/Config.in
```kconfig
config BR2_PACKAGE_RHAD
	bool "R.H.A.D."
	select BR2_PACKAGE_BLUEZ
	default n
	help
	  The Remote Hardaware Abstraction Daemon (R.H.A.D) 
	  provides an interface to the AS Layer to perfom the Sky 
	  specific bluetooth operations like diagnostics, FindMe, 
	  TV Code configuration, Remote Upgrade etc.
	  The R.H.A.D receives messages from the AS Layer, 
	  understands the message and routes it to the appropriate
	  entity ie, the BlueZ daemon or the corresponding vendor daemon.
```
