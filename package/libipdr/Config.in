## package/libipdr/Config.in
```kconfig
config BR2_PACKAGE_LIBIPDR 
	bool "libipdr"
	help
	 IPDR/XML is an encoding format that directly follows
	 the W3C’s XML and XML- Schema specification’s rules for
	 encoding well-formed and valid XML documents. 
	 And this library is used for TR069 client
```

## package/libs3/Config.in
```kconfig
config BR2_PACKAGE_LIBS3
        bool "libs3"
        help
		 A complete C library API for Amazon S3
```

## package/libsbc/Config.in
```kconfig
config BR2_PACKAGE_LIBSBC
	bool "libsbc"
	help
	  Install the sbc library which is used
	  to support Bluetooth audio streaming.
	  SBC is Sub Band Codec for Bluetooth.

	  http://www.bluez.org/sbc-13/
```

## package/libuuid/Config.in
```kconfig
config BR2_PACKAGE_LIBUUID
        bool "libuuid"
        help
		libuuid library is used to generate unique identifiers 
		for objects that may be accessible beyond the local system.
```

## package/libvirt/Config.in
```kconfig
config BR2_PACKAGE_LIBVIRT
	bool "libvirt"
	help
	  A toolkit to interact with the virtualization
	  capabilities of recent versions of Linux.

	  http://libvirt.org/
```

## package/libxmlsec/Config.in
```kconfig
config BR2_PACKAGE_LIBXMLSEC
	bool "libxmlsec"
	help
	  XML Security Library

	  http://www.aleksey.com/xmlsec/
```

## package/mtd/Config.in
```kconfig
menuconfig BR2_PACKAGE_MTD
	bool "mtd/jffs2 utilities"
	select BR2_PACKAGE_ZLIB
	help
	  Build mtd/jffs utilities

if BR2_PACKAGE_MTD
choice
	prompt "Source package selection"
	depends on BR2_PACKAGE_MTD
	default BR2_PACKAGE_MTD20061007

config BR2_PACKAGE_MTD_UTILS
	bool "Use MTD-utils release"
	depends on BR2_PACKAGE_MTD
	select BR2_PACKAGE_LZO
	help
	  Build mtd/jffs utilities with Dataflash support

config BR2_PACKAGE_MTD_20061007
	bool "Use MTD snapshot from 20061007"
	depends on BR2_PACKAGE_MTD
	help
	  Build mtd/jffs utilities with Dataflash support

config BR2_PACKAGE_MTD_20050122
	bool "Use MTD snapshot from 20050122"
	help
	  Use the stable release.

config BR2_PACKAGE_MTD_UTILS_GIT
	bool "Use MTD-utils from GIT"
	help
	  Use the latest from GIT or a particular revision.
	  You should probably say NO except for specific purpose.

endchoice

comment "MTD tools selection"
	depends on BR2_PACKAGE_MTD

config BR2_PACKAGE_MTD_DOCFDISK
	bool "docfdisk"
	default y
	depends on BR2_PACKAGE_MTD

config BR2_PACKAGE_MTD_DOC_LOADBIOS
	bool "doc_loadbios"
	default y
	depends on BR2_PACKAGE_MTD

config BR2_PACKAGE_MTD_FLASHCP
	bool "flashcp"
	default y
	depends on BR2_PACKAGE_MTD

config BR2_PACKAGE_MTD_FLASH_ERASE
	bool "flash_erase"
	default y
	depends on BR2_PACKAGE_MTD

config BR2_PACKAGE_MTD_FLASH_ERASEALL
	bool "flash_eraseall"
	default y
	depends on BR2_PACKAGE_MTD

config BR2_PACKAGE_MTD_FLASH_INFO
	bool "flash_info"
	default y
	depends on BR2_PACKAGE_MTD

config BR2_PACKAGE_MTD_FLASH_LOCK
	bool "flash_lock"
	default y
	depends on BR2_PACKAGE_MTD

config BR2_PACKAGE_MTD_FLASH_OTP_DUMP
	bool "flash_otp_dump"
	default y
	depends on BR2_PACKAGE_MTD

config BR2_PACKAGE_MTD_FLASH_OTP_INFO
	bool "flash_otp_info"
	default y
	depends on BR2_PACKAGE_MTD

config BR2_PACKAGE_MTD_FLASH_OTP_LOCK
	bool "flash_otp_lock"
	default y
	depends on BR2_PACKAGE_MTD

config BR2_PACKAGE_MTD_FLASH_OTP_WRITE
	bool "flash_otp_write"
	default y
	depends on BR2_PACKAGE_MTD

config BR2_PACKAGE_MTD_FLASH_UNLOCK
	bool "flash_unlock"
	default y
	depends on BR2_PACKAGE_MTD

config BR2_PACKAGE_MTD_FTL_CHECK
	bool "ftl_check"
	default y
	depends on BR2_PACKAGE_MTD

config BR2_PACKAGE_MTD_FTL_FORMAT
	bool "ftl_format"
	default y
	depends on BR2_PACKAGE_MTD

config BR2_PACKAGE_MTD_JFFS2DUMP
	bool "jffs2dump"
	default y
	depends on BR2_PACKAGE_MTD

config BR2_PACKAGE_MTD_JFFS3DUMP
	bool "jffs3dump"
	default y
	depends on BR2_PACKAGE_MTD_20050122

config BR2_PACKAGE_MTD_MKFSJFFS2
	bool "mkfs.jffs2"
	default y
	depends on BR2_PACKAGE_MTD

config BR2_PACKAGE_MTD_MKFSUBIFS
	bool "mkfs.ubifs"
	default y
	depends on BR2_PACKAGE_MTD

config BR2_PACKAGE_MTD_MKFSJFFS
	bool "mkfs.jffs"
	default y
	depends on BR2_PACKAGE_MTD_20050122 || BR2_PACKAGE_MTD_20061007 || BR2_PACKAGE_MTD_UTILS

config BR2_PACKAGE_MTD_MTD_DEBUG
	bool "mtd_debug"
	default y
	depends on BR2_PACKAGE_MTD

config BR2_PACKAGE_MTD_NANDDUMP
	bool "nanddump"
	default y
	depends on BR2_PACKAGE_MTD

config BR2_PACKAGE_MTD_NANDTEST
	bool "nandtest"
	default y
	depends on BR2_PACKAGE_MTD

config BR2_PACKAGE_MTD_NANDWRITE
	bool "nandwrite"
	default y
	depends on BR2_PACKAGE_MTD

config BR2_PACKAGE_MTD_NFTL_FORMAT
	bool "nftl_format"
	default y
	depends on BR2_PACKAGE_MTD

config BR2_PACKAGE_MTD_NFTLDUMP
	bool "nftldump"
	default y
	depends on BR2_PACKAGE_MTD

config BR2_PACKAGE_MTD_MTDINFO
	bool "mtdinfo"
	default y
	depends on BR2_PACKAGE_MTD

config BR2_PACKAGE_MTD_SUMTOOL
	bool "sumtool"
	default y
	depends on BR2_PACKAGE_MTD

config BR2_PACKAGE_MTD_UBIATTACH
	bool "ubiattach"
	default y
	depends on BR2_PACKAGE_MTD

config BR2_PACKAGE_MTD_UBICRC32
	bool "ubicrc32"
	default y
	depends on BR2_PACKAGE_MTD

config BR2_PACKAGE_MTD_UBIDETACH
	bool "ubidetach"
	default y
	depends on BR2_PACKAGE_MTD

config BR2_PACKAGE_MTD_UBIFORMAT
	bool "ubiformat"
	default y
	depends on BR2_PACKAGE_MTD

config BR2_PACKAGE_MTD_UBIMKVOL
	bool "ubimkvol"
	default y
	depends on BR2_PACKAGE_MTD

config BR2_PACKAGE_MTD_UBINFO
	bool "ubinfo"
	default y
	depends on BR2_PACKAGE_MTD

config BR2_PACKAGE_MTD_UBINIZE
	bool "ubinize"
	default y
	depends on BR2_PACKAGE_MTD

config BR2_PACKAGE_MTD_UBIRENAME
	bool "ubirename"
	default y
	depends on BR2_PACKAGE_MTD

config BR2_PACKAGE_MTD_UBIRMVOL
	bool "ubirmvol"
	default y
	depends on BR2_PACKAGE_MTD

config BR2_PACKAGE_MTD_UBIRSVOL
	bool "ubirsvol"
	default y
	depends on BR2_PACKAGE_MTD

config BR2_PACKAGE_MTD_UBIUPDATEVOL
	bool "ubiupdatevol"
	default y
	depends on BR2_PACKAGE_MTD

endif
```

## package/multimedia/gstreamer/Config.in
```kconfig
config BR2_PACKAGE_GSTREAMER
	bool "gstreamer"
	select BR2_PACKAGE_LIBGLIB2
	select BR2_PACKAGE_LIBXML2
	help
	  GStreamer is an open source multimedia framework.

	  http://gstreamer.freedesktop.org/

if BR2_PACKAGE_GSTREAMER
source "package/multimedia/gstreamer/gst-plugins-base/Config.in"
source "package/multimedia/gstreamer/gst-plugins-good/Config.in"
source "package/multimedia/gstreamer/gst-plugins-ugly/Config.in"
endif
```

## package/multimedia/gstreamer1/gstreamer1/Config.in
```kconfig
config BR2_PACKAGE_GSTREAMER1
	bool "gstreamer 1.x"
	select BR2_PACKAGE_LIBGLIB2
	help
	  GStreamer is an open source multimedia framework. This 1.x version of
	  Gstreamer is incompatible with Gstreamer 0.10.x.

	  http://gstreamer.freedesktop.org/

if BR2_PACKAGE_GSTREAMER1

config BR2_PACKAGE_GSTREAMER1_PARSE
	bool "enable command-line parser"
	default y
	help
	  Enable command line parser for gstreamer. This may incrase the CPu
	  overhead by a small amount.

config BR2_PACKAGE_GSTREAMER1_TRACE
	bool "enable tracing subsystem"
	default y
	help
	  Enable the tracing subsystem within gstreamer.  This may increase CPU
	  overhead by a small amount.

config BR2_PACKAGE_GSTREAMER1_GST_DEBUG
	bool "enable gst-debug trace support"
	default y
	help
	  Enable support for the gst-debug tracing functionality in gstreamer.
	  This has limited CPU overhead, but does increase the rootfs size
	  somewhat.

config BR2_PACKAGE_GSTREAMER1_PLUGIN_REGISTRY
	bool "enable plugin registry"
	default y
	help
	  Enable support for the GStreamer plugin registry. This may increase
	  the launch-time for a GStreamer application.

config BR2_PACKAGE_GSTREAMER1_INSTALL_TOOLS
	bool "install gst-launch & gst-inspect"
	default y
	help
	  Install the gst-launch and gst-inspect tools. This will take up
	  additional space on the target.

endif
```

## package/netcf/Config.in
```kconfig
config BR2_PACKAGE_NETCF
	bool "netcf"
	select BR2_PACKAGE_AUGEAS
	help
	  A library for configuring network interfaces 

	  https://fedorahosted.org/netcf/
```

## package/netkitrsh/Config.in
```kconfig
config BR2_PACKAGE_NETKITRSH
	bool "netkitrsh"
	help
	  Standard Linux remote shell (rsh) client and server.

	  ftp://ftp.uk.linux.org/pub/linux/Networking/netkit/
```

## package/nss-mdns/Config.in
```kconfig
config BR2_PACKAGE_NSS_MDNS
        bool "nss-mdns"
        help
		nss-mdns is a plugin for the GNU Name Service Switch (NSS) 
		functionality of the GNU C Library (glibc) providing 
		host name resolution
```

## package/plc-utils/Config.in
```kconfig
config BR2_PACKAGE_PLC_UTILS
        bool "plc-utils"
        help
	  	plc-utils for plc support.
```

## package/ply/Config.in
```kconfig
config BR2_PACKAGE_PLY
	bool "ply"
	help
	   PLY (Python Lex-Yacc) is an implementation of lex and yacc
	   parsing tools for Python.
```

## package/rng-tools/Config.in
```kconfig
config BR2_PACKAGE_RNG_TOOLS
        bool "rng-tools"
        help
		The rng-tools is a set of utilities related to random number 
		generation in kernel. The main program is rngd, a daemon 
		developed to check and feed random data from hardware device 
		to kernel entropy pool.
```

## package/sky-common/Config.in
```kconfig
config BR2_PACKAGE_SKY_COMMON
        bool "Select packages for Sky/Humax platforms"
	depends on BR2_TARGET_SKY || BR2_TARGET_HUMAX
        help
          Packages for Sky common platforms

menu "Sky common shared packages"
source "package/sky-common/firewall/Config.in"
source "package/sky-common/cdi/Config.in"
source "package/sky-common/nds/Config.in"
source "package/sky-common/bumper/Config.in"
source "package/sky-common/httpsend/Config.in"
source "package/sky-common/mali/Config.in"
source "package/sky-common/wpa_supplicant/Config.in"
source "package/sky-common/maid-amidala/Config.in"
source "package/sky-common/rhad/Config.in"
source "package/sky-common/upstart-user/Config.in"
source "package/sky-common/false/Config.in"
source "package/sky-common/writefile/Config.in"
if !BR2_PACKAGE_BUSYBOX_HIDE_OTHERS
source "package/sky-common/echo/Config.in"
endif
endmenu
```

## package/sky-common/bumper/Config.in
```kconfig
config BR2_PACKAGE_BUMPER
	bool "bumper"
	help
	  bumper is a simple, small, portable, fast app
	  for batch elevating application priority
```

## package/sky-common/cdi/Config.in
```kconfig
config BR2_PACKAGE_SKY_CDI_DRIVERS
	bool "CDI drivers"
	default N
	help
	  Include the platform's CDI drivers in the rootfs. If
	  enabled, the drivers will be loaded and configured at boot.
```

## package/sky-common/echo/Config.in
```kconfig
config BR2_PACKAGE_ECHO
	bool "echo"
	default n
	help
	A static utilty which does nothing but return success always.
	Added to replace the busybox echo.
```

## package/sky-common/false/Config.in
```kconfig
config BR2_PACKAGE_FALSE
	bool "false"
	help
	  false is a simple, small, static, portable 
	  app for replacing the busybox false
```

## package/sky-common/firewall/Config.in
```kconfig
config BR2_PACKAGE_SKY_FIREWALL
	bool "Firewall"
	default N
	help
	  Enables the firewall on the STB.


config BR2_PACKAGE_SKY_FIREWALL_TURN_ON_TEXT
	bool "Turn on Firewall script text"
	depends on BR2_PACKAGE_SKY_FIREWALL
	default y
	help
	  This allows turning script text off in prod variant.

config BR2_PACKAGE_SKY_FIREWALL_ENABLE_LOGS
	bool "Turn on Firewall logs"
	depends on BR2_PACKAGE_SKY_FIREWALL
	default y
	help
	  This option enables the logs for the firewall.

config BR2_PACKAGE_SKY_FIREWALL_PROC_SYS
	bool "Use /proc/sys/net to lock down networking"
	depends on BR2_PACKAGE_SKY_FIREWALL
	default y
	help
	  When selected the firewall initialisation.
	  script will use the available /proc/sys/net 
	  interfaces to secure networking features
	  

config BR2_PACKAGE_SKY_FIREWALL_ALLOW_HTTP
	bool "Allow HTTP requests/replies"
	depends on BR2_PACKAGE_SKY_FIREWALL
	default y
	help
	  When selected allows HTTP requests from the STB and their
	  responses.

config BR2_PACKAGE_SKY_FIREWALL_ALLOW_DHCP
	bool "Allow DHCP requests/replies"
	depends on BR2_PACKAGE_SKY_FIREWALL
	default y
	help
	  When selected allows DHCP requests from the STB and their
	  responses.

config BR2_PACKAGE_SKY_FIREWALL_ALLOW_DNS
	bool "Allow DNS requests/replies"
	depends on BR2_PACKAGE_SKY_FIREWALL
	default y
	help
	  When selected allows DNS requests from the STB and their
	  responses.

config BR2_PACKAGE_SKY_FIREWALL_ALLOW_PING
	bool "Allow ping requests/replies"
	depends on BR2_PACKAGE_SKY_FIREWALL
	default y
	help
	  When selected allows ping requests from the STB and their
	  responses.

config BR2_PACKAGE_SKY_FIREWALL_ALLOW_EXTERNAL_PING
	bool "Allow external ping requests/responses"
	depends on BR2_PACKAGE_SKY_FIREWALL
	default y
	help
	  When selected allows external (to the STB) ping requests and
	  responses. 

config BR2_PACKAGE_SKY_FIREWALL_ALLOW_DIAG_ICMP
	bool "Allow ICMP remote diagnostic requests/responses"
	depends on BR2_PACKAGE_SKY_FIREWALL
	default y
	help
	  When selected allows diagnostic ICMP requests through the
	  firewall and their responses.

config BR2_PACKAGE_SKY_FIREWALL_ALLOW_OQTP
	bool "Allow OQTP (NDS Proprietary) requests/replies"
	depends on BR2_PACKAGE_SKY_FIREWALL
	default y
	help
	  When selected allows OQTP requests from the STB and their
	  responses.

config BR2_PACKAGE_SKY_FIREWALL_ALLOW_CA_CALLBACK
	bool "Allow CA callback requests/replies over PPP link (Experimental)"
	depends on BR2_PACKAGE_SKY_FIREWALL
	default y
	help
	  When selected allows CA callback messages over the PPP modem link.

config BR2_PACKAGE_SKY_FIREWALL_ALLOW_PPP_HTTP
	bool "Allow HTTP requests/replies over PPP link (Experimental)"
	depends on BR2_PACKAGE_SKY_FIREWALL
	default y
	help
	  When selected allows HTTP requests over the PPP modem link.

config BR2_PACKAGE_SKY_FIREWALL_ALLOW_FTP
	bool "Allow FTP requests/replies"
	depends on BR2_PACKAGE_SKY_FIREWALL
	default y
	help
	  Enable FTP put operations from the STB, this should
	  be enabled for the debug and pre-production builds.

config BR2_PACKAGE_SKY_FIREWALL_ALLOW_MW_DEBUG
	bool "Allow MW debugging requests/replies"
	depends on BR2_PACKAGE_SKY_FIREWALL
	default y
	help
	  When selected allows traffic to/from the STB on port 5555. This
	  is the MW debug port.

config BR2_PACKAGE_SKY_FIREWALL_ALLOW_GDBSERVER
	bool "Allow GDB server requests/replies"
	depends on BR2_PACKAGE_SKY_FIREWALL
	default y
	help
	  When selected allows traffic to/from the STB on port 12345. This
	  is the reserved port for GDB server.

config BR2_PACKAGE_SKY_FIREWALL_ALLOW_TELNET
	bool "Allow Telnet access"
	depends on BR2_PACKAGE_SKY_FIREWALL
	default y
	help
	  When selected allows telnet login to the box.

config BR2_PACKAGE_SKY_FIREWALL_ALLOW_HFL_DEBUG
	bool "Allow HFL Studio debugging requests/replies"
	depends on BR2_PACKAGE_SKY_FIREWALL
	default y
	help
	  When selected allows traffic to/from the STB on port 20077. This 
	  is the HFL Studio debug port.

config BR2_PACKAGE_SKY_FIREWALL_ALLOW_UPNP
	bool "NDS UPNP enabled"
	depends on BR2_PACKAGE_SKY_FIREWALL
	default y
	help
	  Allow incoming UDP 1900 TCP 5900 49153.

config BR2_PACKAGE_SKY_FIREWALL_ALLOW_MR_GW_COMM
	bool "SI Multiroom Gateway communication port"
	depends on BR2_PACKAGE_SKY_FIREWALL
	default y
	help
	  Allow  TCP  49155 open.
config BR2_PACKAGE_SKY_FIREWALL_ALLOW_SSH
        bool "Allow SSH requests/replies"
        depends on BR2_PACKAGE_SKY_FIREWALL
        default y
        help
          When selected allows SSH tarffic on port 22.
config BR2_PACKAGE_SKY_FIREWALL_ALLOW_FUSION_SLAVE_SOAP_PORT
        bool "Allows requests/replies  on port 9997 to 9999"
        depends on BR2_PACKAGE_SKY_FIREWALL
        default y
        help
          When selected allows  tarffic on port 9997 to 9999.
config BR2_PACKAGE_SKY_FIREWALL_ALLOW_CISCO_FIREWALL
        bool "Cisco Update to Firewall"
        depends on BR2_PACKAGE_SKY_FIREWALL
        default y
        help
          When selected turns on Cisco Firewall update.
```

## package/sky-common/httpsend/Config.in
```kconfig
config BR2_PACKAGE_SKY_HTTPSEND
	bool "httpsend"
	help
	  httpsend is a small app to replace ftp uploading.
```
