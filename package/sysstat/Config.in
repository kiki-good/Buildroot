## package/sysstat/Config.in
```kconfig
config BR2_PACKAGE_SYSSTAT
	bool "sysstat"
	help
	  system statistics utility

	  Sysstat
```

## package/termcap/Config.in
```kconfig
config BR2_PACKAGE_TERMCAP
	bool "termcap"
	help
	   Library termcap Package
	  
```

## package/udev/Config.in
```kconfig
config BR2_PACKAGE_UDEV
	bool "udev"
	default n
	select BR2_PACKAGE_LIBACL
	select BR2_PACKAGE_USBUTILS
	select BR2_PACKAGE_PCIUTILS
	select BR2_PACKAGE_LIBGLIB2
	help
	  Userspace device daemon.

	  ftp://ftp.kernel.org/pub/linux/utils/kernel/hotplug/

config BR2_PACKAGE_UDEV_UTILS
	bool "udev-utils"
	depends on BR2_PACKAGE_UDEV
	help
	  Adds the udevmonitor, udevinfo, and udevtest binaries
	  to your filesystem.

menu "Extra udev tools"
	depends on BR2_PACKAGE_UDEV

config BR2_PACKAGE_UDEV_VOLUME_ID
	bool "udev-libvolume_id"
	depends on BR2_PACKAGE_UDEV
	help
	  Build and install volume identification library.

config BR2_PACKAGE_UDEV_SCSI_ID
	bool "udev-scsi_id"
	depends on BR2_PACKAGE_UDEV_VOLUME_ID
	help
	  Build and install SCSI disk identification library.

endmenu
```

## package/upstart/Config.in
```kconfig
config BR2_PACKAGE_UPSTART
        bool "upstart"
        help
		Upstart is an event-based replacement for the /sbin/init
		daemon which handles starting of tasks and services
		during boot, stopping them during shutdown and supervising 
		them while the system is running.
```

## package/userver/Config.in
```kconfig
config BR2_PACKAGE_USERVER
	bool "UEI Daemon"
	select BR2_PACKAGE_BLUEZ
	default n
	help
		UEI Bluetooth Daemon
```

## package/wayland/Config.in
```kconfig
config BR2_PACKAGE_WAYLAND
	bool "wayland"
	depends on BR2_PACKAGE_LIBFFI
	help
	  Wayland window manager protocol libraries.
		
	  http://wayland.freedesktop.org/
```

## package/xz-utils/Config.in
```kconfig
config BR2_PACKAGE_XZ_UTILS_HOST
	bool "Install XZ-Utils(LZMA) for the host/build system"
	help
	  XZ utils on the host (includes lzma)

	  http://tukaani.org/xz/
```
