## package/sky-common/upstart-user/Config.in
```kconfig
config BR2_PACKAGE_SKY_UPSTART_USER
	bool "upstart-user"
	default N
	help
	  Enables the new upstart-user.
```

## package/sky-common/wpa_supplicant/Config.in
```kconfig
config BR2_PACKAGE_SKY_WPA_SUPPLICANT
	bool "WPA_SUPPLICANT"
	default n
	help
	Wpa supplicant needed for wifi operations. 
	
```

## package/sky-common/writefile/Config.in
```kconfig
config BR2_PACKAGE_SKY_WRITEFILE
	bool "writefile"
	help
	  writefile is a simple, small, static, portable 
	  app for writing values to files (similar to echo)
```

## package/sky/Config.in
```kconfig
menu "Sky packages"

source "package/sky/mesh/Config.in"
source "package/sky/maid/Config.in"
source "package/sky/skyRssiData/Config.in"
source "package/sky/plcanalyse/Config.in"
source "package/sky/getmac/Config.in"
source "package/sky/otpMeshData/Config.in"
source "package/sky/fileCapMesh/Config.in"
source "package/sky/mountMeshData/Config.in"
source "package/sky/cmdLineMesh/Config.in"
source "package/sky/skelmir/Config.in"
source "package/sky/craftworks/Config.in"
source "package/sky/picasso/Config.in"
source "package/sky/scs/Config.in"
source "package/sky/support/Config.in"
source "package/sky/nxp-kal/Config.in"
source "package/sky/diagnostics/Config.in"
source "package/sky/ruwido/Config.in"
source "package/sky/bluetooth_address_programmer/Config.in"
source "package/sky/procproxy/Config.in"
endmenu
```

## package/sky/bluetooth_address_programmer/Config.in
```kconfig
config BR2_PACKAGE_BT_ADDR_PGM
	bool "Bluetooth Address Programmer"
	default n
	help
		This tool reads the bluetooth address available in flash and 
		programs it to the Bluetooth chip
```

## package/sky/cmdLineMesh/Config.in
```kconfig
config BR2_PACKAGE_CMDLINEMESH
        bool "cmdLineMesh"
        help
		To replace cmdline check for mesh on/off using cat cmd
```

## package/sky/craftworks/Config.in
```kconfig
config BR2_PACKAGE_SKY_CRAFTWORKS
	bool "Craftworks LAE"
	default N
	help
	  Include the Craftworks LAE in the rootfs.

if BR2_PACKAGE_SKY_CRAFTWORKS

# When adding new versions, make sure that a corresponding entry is
# added to the default values of BR2_PACKAGE_CRAFTWORKS_VERSION below.

choice
	prompt "Craftworks VM version"
	depends on BR2_PACKAGE_SKY_CRAFTWORKS
	default BR2_PACKAGE_SKY_CRAFTWORKS_0_1

config BR2_PACKAGE_SKY_CRAFTWORKS_0_1
	bool "Use Craftworks VM 0.1"
	depends on BR2_PACKAGE_SKY_CRAFTWORKS

endchoice

config BR2_PACKAGE_SKY_CRAFTWORKS_VERSION
	string
	default "0.1"		if BR2_PACKAGE_SKY_CRAFTWORKS_0_1

endif
```

## package/sky/diagnostics/Config.in
```kconfig
config BR2_PACKAGE_DIAGNOSTICS
	bool "diagnostics"
	select BR2_PACKAGE_LIBCOM_ERR
	select BR2_PACKAGE_LIBEVENT
	select BR2_PACKAGE_LIBXML2
	select BR2_PACKAGE_LIBGPG_ERROR
	select BR2_PACKAGE_LIBGCRYPT
	select BR2_PACKAGE_ARPCGEN
	select BR2_PACKAGE_PLY
	select BR2_PACKAGE_IKSEMEL
	select BR2_PACKAGE_OPENSSL
	help
	  This is the Pace TR-069 client package


config BR2_PACKAGE_DIAGNOSTICS_ENABLE_UPLOADD
	bool "Enable Diagnostics Daemon Uploadd?"
	depends on BR2_PACKAGE_DIAGNOSTICS
	help
	  Enable Diagnostics Daemon Uploadd


config BR2_PACKAGE_DIAGNOSTICS_ENABLE_XMPPD
	bool "Enable Diagnostics Daemon Xmppd?"
	depends on BR2_PACKAGE_DIAGNOSTICS
	help
	  Enable Diagnostics Daemon Xmppd
```

## package/sky/fileCapMesh/Config.in
```kconfig
config BR2_PACKAGE_FILECAPMESH
        bool "fileCapMesh"
        help
		fileCapMesh will set the capabilities of the mesh files
```

## package/sky/getmac/Config.in
```kconfig
config BR2_PACKAGE_GETMAC
        bool "getmac"
        help
		gitmac will read the mac address from the specific address
```

## package/sky/maid/Config.in
```kconfig
config BR2_PACKAGE_MAID
	bool "M.A.I.D."
	select BR2_PACKAGE_LIBGLIB2
	select BR2_PACKAGE_DBUS
	default n
	help
	  The Mesh API Interface Daemon (M.A.I.D) provides an interface 
	  to the AS Layer as well as the NGI to perfom Mesh specific tasks. 
	  It also exposes a library with the LAN sub-system uses.
	
```

## package/sky/mesh/Config.in
```kconfig
config BR2_PACKAGE_MESH_DRIVERS
	bool "Mesh drivers"
	default N
	help
	  Include the Mesh Drivers and executables in the rootfs. If
	  enabled, the drivers will be loaded and configured at boot.
```

## package/sky/mountMeshData/Config.in
```kconfig
config BR2_PACKAGE_MOUNTMESHDATA
        bool "MOUNTMeshData"
        help
		MountMeshData will read the mesh data partition
```

## package/sky/nxp-kal/Config.in
```kconfig
config BR2_PACKAGE_NXP_KAL
	bool "NXP KAL Driver"
	depends on BR2_TARGET_SKY_AMS_DRX780
	default N
	help
	  Build and install the NXP KAL driver.
```

## package/sky/otpMeshData/Config.in
```kconfig
config BR2_PACKAGE_OTPMESHDATA
        bool "otpMeshData"
        help
		otpMeshData will read the mesh data from otp
```

## package/sky/picasso/Config.in
```kconfig
config BR2_PACKAGE_SKY_PICASSO
	bool "Sky Picasso EPG"
	default N
	help
	  Include the Sky Picasso EPG in the rootfs.

if BR2_PACKAGE_SKY_PICASSO

# When adding new versions, make sure that a corresponding entry is
# added to the default values of BR2_PACKAGE_PICASSO_VERSION below.

choice
	prompt "Picasso VM version"
	depends on BR2_PACKAGE_SKY_PICASSO
	default BR2_PACKAGE_SKY_PICASSO_0_1

config BR2_PACKAGE_SKY_PICASSO_0_1
	bool "Use Picasso VM 0.1"
	depends on BR2_PACKAGE_SKY_PICASSO

endchoice

config BR2_PACKAGE_SKY_PICASSO_VERSION
	string
	default "0.1"		if BR2_PACKAGE_SKY_PICASSO_0_1

endif
```

## package/sky/plcanalyse/Config.in
```kconfig
config BR2_PACKAGE_PLCANALYSE_DATA
	bool "PLCANALYSE DATA"
	default n
	help
    This tool will analyse the PLC network, as seen by the local 
	device, and determine whether its peer devices are in adjacent 
	sockets, are in distant sockets and whether there is sufficient 
	noise,  within the PLC network, to cast doubt on the traffic 
	through-put rates which could be achieved.	
```

## package/sky/procproxy/Config.in
```kconfig
config BR2_PACKAGE_SKY_PROCPROXY
        bool "procproxy"
        help
		Allow non-root users to access /proc and /sys.
```

## package/sky/ruwido/Config.in
```kconfig
config BR2_PACKAGE_RUWIDO
	bool "ruwido_daemon"
	select BR2_PACKAGE_BLUEZ
	default n
	help
		Ruwido Bluetooth Daemon
```

## package/sky/scs/Config.in
```kconfig
config BR2_PACKAGE_SKY_SCS
	bool "Service Centre Software (SCS)"
	default N
	help
	  Include the SCS software in the rootfs. If this package is
	  included, SCS software will be automatically started at
	  boot time.
```

## package/sky/skelmir/Config.in
```kconfig
config BR2_PACKAGE_SKY_SKELMIR
	bool "Skelmir Java VM"
	default N
	help
	  Include the Skelmir Java VM in the rootfs.

if BR2_PACKAGE_SKY_SKELMIR

# When adding new versions, make sure that a corresponding entry is
# added to the default values of BR2_PACKAGE_SKELMIR_VERSION below.

choice
	prompt "Skelmir VM version"
	depends on BR2_PACKAGE_SKY_SKELMIR
	default BR2_PACKAGE_SKY_SKELMIR_0_1

config BR2_PACKAGE_SKY_SKELMIR_0_1
	bool "Use Skelmir VM 0.1"
	depends on BR2_PACKAGE_SKY_SKELMIR

endchoice

config BR2_PACKAGE_SKY_SKELMIR_VERSION
	string
	default "0.1"		if BR2_PACKAGE_SKY_SKELMIR_0_1

endif
```

## package/sky/skyRssiData/Config.in
```kconfig
config BR2_PACKAGE_SKY_RSSI_DATA
	bool "R.S.S.I."
	default n
	help
	rssi data daemon that retrieves rssi metrics, tx metrics 
	for all the clients from the wireless driver 
	and save into a /tmp/sky_rssi_data.txt file 
	
```

## package/sky/skybinary/Config.in
```kconfig
config BR2_TARGET_SKY_BINARY_PACKAGE
	bool "BINARY PACKAGE"
	default N
	help
	  Include the platform's BINARY PACKAGE in the rootfs. If
	  enabled, the BINARY will be loaded and configured at boot.
```

## package/sky/support/Config.in
```kconfig
config BR2_PACKAGE_SKY_SUPPORT
	bool "Sky Support software"
	default N
	help
	  Include Sky Support software in the rootfs. If this
	  package is included, the support software will be
	  automatically started at boot time.
```

## package/st_pci/Config.in
```kconfig
config BR2_PACKAGE_ST_PCI
	bool "sti_pci"
	 help
          Added simple cma device with hard coded allocation 
          32MB@0x60000000 to match pcie security feature
```
